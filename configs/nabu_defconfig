## configs/nabu_defconfig
```kconfig
# nabu_defconfig
# build-arm-driver.py 闂佽姘﹂～澶愭偤閺囩儐鍤曢柟鎹愭硾閸?UniXNU-sheng 缂傚倸鍊风粈渚€藝鏉堚晛鍨濇い鏍€涢崶顒€钃熼柕澶涢檮濞呮牠鏌ｈ箛鏇炰哗婵☆偄瀚幏瀣嚑椤掑倻锛?ArmDTPlatform/ArmCpu

CONFIG_XNU_ARM_DT_PLATFORM=y
CONFIG_XNU_ARMCPU=y
CONFIG_XNU_NATIVE_ARCH_TIMER=y
CONFIG_XNU_NATIVE_PAN=y
CONFIG_XNU_DT_PANIC_REGION=y
CONFIG_XNU_SOURCE_CORECRYPTO14=y
CONFIG_XNU_CRYPTO_BOOTSTRAP="prelinked"
CONFIG_XNU_OWNER_DATA_VOLUME_UUID="BEC2158A-350E-4F2E-B87E-A0E69FB0BDEA"
```
